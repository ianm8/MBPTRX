#ifndef SPECTRUM_H
#define SPECTRUM_H

#define FFT_N      1024u
#define FFT_LOG2_N 10u

namespace spectrum
{
  static const uint16_t __not_in_flash("fast_access_sram") color_map_32[32] =
  {
    0x8000u,
    0xA000u,
    0xF800u,
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    0xffffu,
    0xffffu
  };

  static const int16_t __not_in_flash("fast_access_sram") window_hanning_1024[] =
  {
    0,     0,     1,     2,     4,     7,     11,    15,    19,    25,    30,
    37,    44,    52,    60,    69,    79,    89,    100,   111,   123,   136,
    149,   163,   177,   192,   208,   224,   241,   259,   277,   296,   315,
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    0,
  };

    // fft_cos_tab[k] =  cos(2*pi*k/N),  k = 0..N/2-1
  static const float __not_in_flash("fast_access_sram") fft_cos_tab[FFT_N / 2] =
  {
    1.0f, 0.999981165f, 0.999924719f, 0.999830604f, 0.999698818f, 0.999529421f,
    0.999322355f, 0.999077737f, 0.99879545f, 0.998475552f, 0.998118103f, 0.997723043f,
    0.997290432f, 0.996820271f, 0.996312618f, 0.995767415f, 0.99518472f, 0.994564593f,
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    -0.999924719f, -0.999981165f,
  };

  // fft_sin_tab[k] = -sin(2*pi*k/N),  k = 0..N/2-1   (forward transform)
  static const float __not_in_flash("fast_access_sram") fft_sin_tab[FFT_N / 2] =
  {
    0.0f, -0.00613588467f, -0.0122715384f, -0.0184067301f, -0.024541229f, -0.030674804f,
    -0.0368072242f, -0.0429382585f, -0.0490676761f, -0.0551952459f, -0.061320737f, -0.0674439222f,
    -0.0735645667f, -0.0796824396f, -0.0857973099f, -0.0919089541f, -0.0980171412f, -0.104121633f,
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    -0.0122715384f, -0.00613588467f,
  };

  static const uint8_t __not_in_flash_func(log32)(const uint32_t l)
  {
    // return a 5 bit log value
    if (l>4095) return 0x1fu;
    static const uint8_t __not_in_flash("fast_access_sram") logtab32[4096] = 
    {
      0x00u,
      0x01u,
      0x03u,
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      0x1fu,
      0x1fu
    };
    return logtab32[l];
  }

  // In-place forward FFT. re[] and im[] must each hold FFT_N floats and must
  // not overlap.
  static void __not_in_flash_func(fft1024)(float * __restrict re, float * __restrict im)
  {
    // ---- bit-reversal permutation) ----
    uint32_t j = 0;
    for (uint32_t i = 0; i < FFT_N - 1; i++)
    {
      if (i < j)
      {
        const float tr = re[i]; re[i] = re[j]; re[j] = tr;
        const float ti = im[i]; im[i] = im[j]; im[j] = ti;
      }
      uint32_t k = FFT_N >> 1;
      while (k <= j) { j -= k; k >>= 1; }
      j += k;
    }

    // ---- butterflies: 10 stages ----
    for (uint32_t half = 1; half < FFT_N; half <<= 1)
    {
      const uint32_t size = half << 1;
      const uint32_t step = FFT_N / size; // twiddle stride in the table
      for (uint32_t start = 0; start < FFT_N; start += size)
      {
        uint32_t t = 0;
        for (uint32_t m = 0; m < half; m++, t += step)
        {
          const float wr = fft_cos_tab[t];
          const float wi = fft_sin_tab[t];
          const uint32_t a = start + m;
          const uint32_t b = a + half;
          const float xr = re[b] * wr - im[b] * wi;
          const float xi = re[b] * wi + im[b] * wr;
          re[b] = re[a] - xr;   im[b] = im[a] - xi;
          re[a] += xr;          im[a] += xi;
        }
      }
    }
  }

  // I/Q spectrum for the display: Hann window, float FFT, 5 bit log magnitude.
  // Float is used throughout so that a large signal cannot overflow at any
  // gain setting.
  static void __not_in_flash_func(process)(int16_t ii[], int16_t qq[], uint8_t mag[], const int8_t gain, const uint32_t freq)
  {
    static float re[FFT_N] = { 0 };
    static float im[FFT_N] = { 0 };

    // ---- DC estimate -----------------------------------------------------
    // Hann weighted mean of this block. Subtracting it puts an exact null
    // in the centre bin whatever the size of the ADC offset, on receive or
    // transmit. Because the weighting is the window itself, a strong signal
    // away from the centre does not leak into the estimate the way it does
    // with a plain block mean.
    int64_t sum1 = 0;
    int64_t sum2 = 0;
    int32_t sumw = 0;
    for (uint32_t i = 0; i < FFT_N; i++)
    {
      const int32_t w = window_hanning_1024[i];
      sum1 += (int32_t)ii[i] * w;
      sum2 += (int32_t)qq[i] * w;
      sumw += w;
    }
    const float dc1 = (float)sum1 / (float)sumw;
    const float dc2 = (float)sum2 / (float)sumw;

    // ---- DC removal folded into the window multiply ---------------------
    const float scale = ldexpf(1.0f, gain) / (32768.0f * (float)FFT_N);
    for (uint32_t i = 0; i < FFT_N; i++)
    {
      const float w = (float)window_hanning_1024[i] * scale;
      re[i] = ((float)ii[i] - dc1) * w;
      im[i] = ((float)qq[i] - dc2) * w;
    }

    // forward, complex FFT
    fft1024(re, im);

    // magnitude, log, and reverse the frequency bins
    // so that they are in order
    for (int32_t i = 0, j = 511; i < 512; i++, j--)
    {
      mag[i] = log32((uint32_t)sqrtf(re[j] * re[j] + im[j] * im[j]));
    }
    for (int32_t i = 512, j = 1023; i < 1024; i++, j--)
    {
      mag[i] = log32((uint32_t)sqrtf(re[j] * re[j] + im[j] * im[j]));
    }

#ifdef PEDESTAL_FILTER
    if (freq > 15'000'000ul)
    {
      // Pedestal filter: brings the noise pedestal around DC down to the
      // level of the noise just outside it. No cal and no flash.
      //
      // Every bin in the pedestal, and in a guard band either side of it,
      // has a slowly tracked baseline. The baselines are floats in display
      // counts (12*log10 of the magnitude) taken before the 5 bit log, so
      // they keep working when the noise floor is below the bottom of the
      // display. Each baseline tracks the lower quartile of its bin, which
      // signals that come and go (CW, speech) do not pull up. A pedestal bin
      // is reduced by the amount its baseline is above the guard baseline.
      //
      // display index 511 = bin 0 (DC), 512 = bin -1; pedestal spans ~+/-24 bins
      static constexpr int32_t  P_LO     = 511 - 24;       // 487
      static constexpr int32_t  P_HI     = 512 + 24;       // 536
      static constexpr int32_t  P_GUARD  = 8;              // guard bins each side
      static constexpr int32_t  T_LO     = P_LO - P_GUARD; // 479, first tracked bin
      static constexpr int32_t  T_N      = P_HI - P_LO + 1 + 2 * P_GUARD; // 66
      static constexpr float    P_STEP   = 1.0f / 16.0f;   // baseline step, counts per block
      static constexpr float    P_MAX    = 15.0f;          // largest reduction, counts
      static constexpr float    P_MIN    = -48.0f;         // lowest level, counts
      static constexpr uint32_t P_SETTLE = 32;             // fast blocks after a re-seed
      static float    base[T_N];
      static int8_t   last_gain = 127;
      static uint32_t settle = 0;

      // loop() calls this faster than new blocks arrive, so the same block
      // usually comes round several times
      static int64_t last_sum1 = 0;
      static int64_t last_sum2 = 0;
      const bool new_block = (sum1 != last_sum1) || (sum2 != last_sum2);
      last_sum1 = sum1;
      last_sum2 = sum2;

      // level of every tracked bin, in counts
      float lin[T_N];
      float lev[T_N];
      for (int32_t t = 0; t < T_N; t++)
      {
        const int32_t i = T_LO + t;
        const int32_t j = (i < 512) ? (511 - i) : (1535 - i);
        const float p = re[j] * re[j] + im[j] * im[j];
        lin[t] = sqrtf(p);
        // 6*log10(p) = 12*log10(magnitude)
        lev[t] = (p > 1.0e-8f) ? (2.605767f * logf(p)) : P_MIN;
      }

      if (gain != last_gain)                        // re-seed on gain change
      {
        last_gain = gain;
        for (int32_t t = 0; t < T_N; t++)
        {
          base[t] = lev[t];
        }
        settle = P_SETTLE;
      }

      // lower quartile tracker: up one step, down three
      // once per new block, so the rate does not depend on how often
      // loop() gets here
      if (new_block)
      {
        float step = P_STEP;
        if (settle > 0)
        {
          settle--;
          step = 4.0f * P_STEP;
        }
        for (int32_t t = 0; t < T_N; t++)
        {
          if (lev[t] > base[t])
          {
            base[t] += step;
          }
          else if (lev[t] < base[t])
          {
            base[t] -= 3.0f * step;
          }
        }
      }

      // local floor: the lower of the two guard bands, so that a carrier
      // sitting in one of them does not lift it
      float floor_lo = 0.0f;
      float floor_hi = 0.0f;
      for (int32_t t = 0; t < P_GUARD; t++)
      {
        floor_lo += base[t];
        floor_hi += base[T_N - 1 - t];
      }
      const float floor_now = ((floor_lo < floor_hi) ? floor_lo : floor_hi) * (1.0f / (float)P_GUARD);

      for (int32_t t = P_GUARD; t < T_N - P_GUARD; t++)
      {
        float ex = base[t] - floor_now;
        if (ex > P_MAX)
        {
          ex = P_MAX;
        }
        if (ex > 0.0f)
        {
          // 10^(-ex/12)
          const float m = lin[t] * expf(ex * -0.1918821f);
          mag[T_LO + t] = log32((uint32_t)m);
        }
      }
    }
#endif

  }
}

#endif
